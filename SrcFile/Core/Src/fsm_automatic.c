/*
 * fsm_automatic.c
 *
 *  Created on: Sep 20, 2023
 *      Author: 84334
 */
#include "fsm_automatic.h"

void fsm_automatic_run(){
	switch(status){
	case INIT:
		HAL_GPIO_WritePin(LED_RED_GPIO_Port, LED_RED_Pin, GPIO_PIN_RESET);
		HAL_GPIO_WritePin(LED_YELLOW_GPIO_Port, LED_YELLOW_Pin, GPIO_PIN_RESET);
		HAL_GPIO_WritePin(LED_GREEN_GPIO_Port, LED_GREEN_Pin, GPIO_PIN_RESET);
		HAL_GPIO_WritePin(LED_RED_PLUS_GPIO_Port, LED_RED_PLUS_Pin, GPIO_PIN_RESET);
		HAL_GPIO_WritePin(LED_YELLOW_PLUS_GPIO_Port, LED_YELLOW_PLUS_Pin, GPIO_PIN_RESET);
		HAL_GPIO_WritePin(LED_GREEN_PLUS_GPIO_Port, LED_GREEN_PLUS_Pin, GPIO_PIN_RESET);
		status = AUTO_RED3s;
		setTimer1(300);
		break;
	case AUTO_RED3s:
		HAL_GPIO_WritePin(LED_RED_GPIO_Port, LED_RED_Pin, GPIO_PIN_SET);
		HAL_GPIO_WritePin(LED_YELLOW_GPIO_Port, LED_YELLOW_Pin, GPIO_PIN_RESET);
		HAL_GPIO_WritePin(LED_GREEN_GPIO_Port, LED_GREEN_Pin, GPIO_PIN_RESET);
		HAL_GPIO_WritePin(LED_RED_PLUS_GPIO_Port, LED_RED_PLUS_Pin, GPIO_PIN_RESET);
		HAL_GPIO_WritePin(LED_YELLOW_PLUS_GPIO_Port, LED_YELLOW_PLUS_Pin, GPIO_PIN_RESET);
		HAL_GPIO_WritePin(LED_GREEN_PLUS_GPIO_Port, LED_GREEN_PLUS_Pin, GPIO_PIN_SET);
		//2 LED DO 3S, 2 LED XANH 3S
		if(timer1_flag == 1){
			status = AUTO_RED2s;
			setTimer1(200);
		}
		break;
	case AUTO_RED2s:
		HAL_GPIO_WritePin(LED_RED_GPIO_Port, LED_RED_Pin, GPIO_PIN_SET);
		HAL_GPIO_WritePin(LED_YELLOW_GPIO_Port, LED_YELLOW_Pin, GPIO_PIN_RESET);
		HAL_GPIO_WritePin(LED_GREEN_GPIO_Port, LED_GREEN_Pin, GPIO_PIN_RESET);
		HAL_GPIO_WritePin(LED_RED_PLUS_GPIO_Port, LED_RED_PLUS_Pin, GPIO_PIN_RESET);
		HAL_GPIO_WritePin(LED_YELLOW_PLUS_GPIO_Port, LED_YELLOW_PLUS_Pin, GPIO_PIN_SET);
		HAL_GPIO_WritePin(LED_GREEN_PLUS_GPIO_Port, LED_GREEN_PLUS_Pin, GPIO_PIN_RESET);
		//2 LED DO 2S NUA LA 5S, LED VANG 2S
		if(timer1_flag == 1){
			status = AUTO_GREEN;
			setTimer1(300);
		}
		break;
	case AUTO_YELLOW:
		HAL_GPIO_WritePin(LED_RED_GPIO_Port, LED_RED_Pin, GPIO_PIN_RESET);
		HAL_GPIO_WritePin(LED_YELLOW_GPIO_Port, LED_YELLOW_Pin, GPIO_PIN_SET);
		HAL_GPIO_WritePin(LED_GREEN_GPIO_Port, LED_GREEN_Pin, GPIO_PIN_RESET);
		HAL_GPIO_WritePin(LED_RED_PLUS_GPIO_Port, LED_RED_PLUS_Pin, GPIO_PIN_SET);
		HAL_GPIO_WritePin(LED_YELLOW_PLUS_GPIO_Port, LED_YELLOW_PLUS_Pin, GPIO_PIN_RESET);
		HAL_GPIO_WritePin(LED_GREEN_PLUS_GPIO_Port, LED_GREEN_PLUS_Pin, GPIO_PIN_RESET);
		//LED VANG 2S, DO THEM 2S LA 5S
		if(timer1_flag == 1){
			status = AUTO_RED3s;
			setTimer1(300);
		}
		break;
	case AUTO_GREEN:
		HAL_GPIO_WritePin(LED_RED_GPIO_Port, LED_RED_Pin, GPIO_PIN_RESET);
		HAL_GPIO_WritePin(LED_YELLOW_GPIO_Port, LED_YELLOW_Pin, GPIO_PIN_RESET);
		HAL_GPIO_WritePin(LED_GREEN_GPIO_Port, LED_GREEN_Pin, GPIO_PIN_SET);
		HAL_GPIO_WritePin(LED_RED_PLUS_GPIO_Port, LED_RED_PLUS_Pin, GPIO_PIN_SET);
		HAL_GPIO_WritePin(LED_YELLOW_PLUS_GPIO_Port, LED_YELLOW_PLUS_Pin, GPIO_PIN_RESET);
		HAL_GPIO_WritePin(LED_GREEN_PLUS_GPIO_Port, LED_GREEN_PLUS_Pin, GPIO_PIN_RESET);
		//LED XANH 3S, LED DO 3S
		if(timer1_flag == 1){
			status = AUTO_YELLOW;
			setTimer1(200);
		}
		break;
	default:
		break;
	}
}

